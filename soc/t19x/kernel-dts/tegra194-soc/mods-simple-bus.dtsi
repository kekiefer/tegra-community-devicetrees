/*
 * Copyright (c) 2017-2020, NVIDIA CORPORATION.  All rights reserved.
 *
 * This program is free software; you can redistribute it and/or modify it
 * under the terms and conditions of the GNU General Public License,
 * version 2, as published by the Free Software Foundation.
 *
 * This program is distributed in the hope it will be useful, but WITHOUT
 * ANY WARRANTY; without even the implied warranty of MERCHANTABILITY or
 * FITNESS FOR A PARTICULAR PURPOSE.  See the GNU General Public License for
 * more details.
 *
 * You should have received a copy of the GNU General Public License
 * along with this program.  If not, see <http://www.gnu.org/licenses/>.
 */

#include <dt-bindings/clock/tegra194-clock.h>
#include <dt-bindings/reset/tegra194-reset.h>

/ {
	mods-simple-bus {
			compatible = "simple-bus";
			device_type = "mods-simple-bus";
			#address-cells = <1>;
			#size-cells = <0>;

			mods-clocks {
				compatible = "nvidia,mods-clocks";
				status = "disabled";
				clocks = <&bpmp TEGRA194_CLK_ACTMON>,
					<&bpmp TEGRA194_CLK_ADSP>,
					<&bpmp TEGRA194_CLK_ADSPNEON>,
					<&bpmp TEGRA194_CLK_AHUB>,
					<&bpmp TEGRA194_CLK_APB2APE>,
					<&bpmp TEGRA194_CLK_APE>,
					<&bpmp TEGRA194_CLK_AUD_MCLK>,
					<&bpmp TEGRA194_CLK_AXI_CBB>,
					<&bpmp TEGRA194_CLK_CAN1>,
					<&bpmp TEGRA194_CLK_CAN1_HOST>,
					<&bpmp TEGRA194_CLK_CAN2>,
					<&bpmp TEGRA194_CLK_CAN2_HOST>,
					<&bpmp TEGRA194_CLK_CEC>,
					<&bpmp TEGRA194_CLK_CLK_M>,
					<&bpmp TEGRA194_CLK_DMIC1>,
					<&bpmp TEGRA194_CLK_DMIC2>,
					<&bpmp TEGRA194_CLK_DMIC3>,
					<&bpmp TEGRA194_CLK_DMIC4>,
					<&bpmp TEGRA194_CLK_DPAUX>,
					<&bpmp TEGRA194_CLK_DPAUX1>,
					<&bpmp TEGRA194_CLK_ACLK>,
					<&bpmp TEGRA194_CLK_MSS_ENCRYPT>,
					<&bpmp TEGRA194_CLK_EQOS_RX_INPUT>,
					<&bpmp TEGRA194_CLK_IQC2>,
					<&bpmp TEGRA194_CLK_AON_APB>,
					<&bpmp TEGRA194_CLK_AON_NIC>,
					<&bpmp TEGRA194_CLK_AON_CPU_NIC>,
					<&bpmp TEGRA194_CLK_PLLA1>,
					<&bpmp TEGRA194_CLK_DSPK1>,
					<&bpmp TEGRA194_CLK_DSPK2>,
					<&bpmp TEGRA194_CLK_EMC>,
					<&bpmp TEGRA194_CLK_EQOS_AXI>,
					<&bpmp TEGRA194_CLK_EQOS_PTP_REF>,
					<&bpmp TEGRA194_CLK_EQOS_RX>,
					<&bpmp TEGRA194_CLK_EQOS_TX>,
					<&bpmp TEGRA194_CLK_EXTPERIPH1>,
					<&bpmp TEGRA194_CLK_EXTPERIPH2>,
					<&bpmp TEGRA194_CLK_EXTPERIPH3>,
					<&bpmp TEGRA194_CLK_EXTPERIPH4>,
					<&bpmp TEGRA194_CLK_FUSE>,
					<&bpmp TEGRA194_CLK_GPCCLK>,
					<&bpmp TEGRA194_CLK_GPU_PWR>,
					<&bpmp TEGRA194_CLK_HDA>,
					<&bpmp TEGRA194_CLK_HDA2CODEC_2X>,
					<&bpmp TEGRA194_CLK_HDA2HDMICODEC>,
					<&bpmp TEGRA194_CLK_HOST1X>,
					<&bpmp TEGRA194_CLK_HSIC_TRK>,
					<&bpmp TEGRA194_CLK_I2C1>,
					<&bpmp TEGRA194_CLK_I2C2>,
					<&bpmp TEGRA194_CLK_I2C3>,
					<&bpmp TEGRA194_CLK_I2C4>,
					<&bpmp TEGRA194_CLK_I2C6>,
					<&bpmp TEGRA194_CLK_I2C7>,
					<&bpmp TEGRA194_CLK_I2C8>,
					<&bpmp TEGRA194_CLK_I2C9>,
					<&bpmp TEGRA194_CLK_I2S1>,
					<&bpmp TEGRA194_CLK_I2S1_SYNC_INPUT>,
					<&bpmp TEGRA194_CLK_I2S2>,
					<&bpmp TEGRA194_CLK_I2S2_SYNC_INPUT>,
					<&bpmp TEGRA194_CLK_I2S3>,
					<&bpmp TEGRA194_CLK_I2S3_SYNC_INPUT>,
					<&bpmp TEGRA194_CLK_I2S4>,
					<&bpmp TEGRA194_CLK_I2S4_SYNC_INPUT>,
					<&bpmp TEGRA194_CLK_I2S5>,
					<&bpmp TEGRA194_CLK_I2S5_SYNC_INPUT>,
					<&bpmp TEGRA194_CLK_I2S6>,
					<&bpmp TEGRA194_CLK_I2S6_SYNC_INPUT>,
					<&bpmp TEGRA194_CLK_IQC1>,
					<&bpmp TEGRA194_CLK_ISP>,
					<&bpmp TEGRA194_CLK_KFUSE>,
					<&bpmp TEGRA194_CLK_MAUD>,
					<&bpmp TEGRA194_CLK_MIPI_CAL>,
					<&bpmp TEGRA194_CLK_MPHY_CORE_PLL_FIXED>,
					<&bpmp TEGRA194_CLK_MPHY_L0_RX_ANA>,
					<&bpmp TEGRA194_CLK_MPHY_L0_RX_LS_BIT>,
					<&bpmp TEGRA194_CLK_MPHY_L0_RX_SYMB>,
					<&bpmp TEGRA194_CLK_MPHY_L0_TX_LS_3XBIT>,
					<&bpmp TEGRA194_CLK_MPHY_L0_TX_SYMB>,
					<&bpmp TEGRA194_CLK_MPHY_L1_RX_ANA>,
					<&bpmp TEGRA194_CLK_MPHY_TX_1MHZ_REF>,
					<&bpmp TEGRA194_CLK_NVCSI>,
					<&bpmp TEGRA194_CLK_NVCSILP>,
					<&bpmp TEGRA194_CLK_NVDEC>,
					<&bpmp TEGRA194_CLK_NVDISPLAYHUB>,
					<&bpmp TEGRA194_CLK_NVDISPLAY_DISP>,
					<&bpmp TEGRA194_CLK_NVDISPLAY_P0>,
					<&bpmp TEGRA194_CLK_NVDISPLAY_P1>,
					<&bpmp TEGRA194_CLK_NVDISPLAY_P2>,
					<&bpmp TEGRA194_CLK_NVENC>,
					<&bpmp TEGRA194_CLK_NVJPG>,
					<&bpmp TEGRA194_CLK_OSC>,
					<&bpmp TEGRA194_CLK_AON_TOUCH>,
					<&bpmp TEGRA194_CLK_PLLA>,
					<&bpmp TEGRA194_CLK_PLLAON>,
					<&bpmp TEGRA194_CLK_PLLD>,
					<&bpmp TEGRA194_CLK_PLLD2>,
					<&bpmp TEGRA194_CLK_PLLD3>,
					<&bpmp TEGRA194_CLK_PLLDP>,
					<&bpmp TEGRA194_CLK_PLLD4>,
					<&bpmp TEGRA194_CLK_PLLE>,
					<&bpmp TEGRA194_CLK_PLLP>,
					<&bpmp TEGRA194_CLK_PLLP_OUT0>,
					<&bpmp TEGRA194_CLK_UTMIPLL>,
					<&bpmp TEGRA194_CLK_PLLA_OUT0>,
					<&bpmp TEGRA194_CLK_PWM1>,
					<&bpmp TEGRA194_CLK_PWM2>,
					<&bpmp TEGRA194_CLK_PWM3>,
					<&bpmp TEGRA194_CLK_PWM4>,
					<&bpmp TEGRA194_CLK_PWM5>,
					<&bpmp TEGRA194_CLK_PWM6>,
					<&bpmp TEGRA194_CLK_PWM7>,
					<&bpmp TEGRA194_CLK_PWM8>,
					<&bpmp TEGRA194_CLK_RCE_CPU_NIC>,
					<&bpmp TEGRA194_CLK_RCE_NIC>,
					<&bpmp TEGRA194_CLK_SATA>,
					<&bpmp TEGRA194_CLK_SATA_OOB>,
					<&bpmp TEGRA194_CLK_AON_I2C_SLOW>,
					<&bpmp TEGRA194_CLK_SCE_CPU_NIC>,
					<&bpmp TEGRA194_CLK_SCE_NIC>,
					<&bpmp TEGRA194_CLK_SDMMC1>,
					<&bpmp TEGRA194_CLK_UPHY_PLL3>,
					<&bpmp TEGRA194_CLK_SDMMC3>,
					<&bpmp TEGRA194_CLK_SDMMC4>,
					<&bpmp TEGRA194_CLK_SE>,
					<&bpmp TEGRA194_CLK_SOR0_OUT>,
					<&bpmp TEGRA194_CLK_SOR0_REF>,
					<&bpmp TEGRA194_CLK_SOR0_PAD_CLKOUT>,
					<&bpmp TEGRA194_CLK_SOR1_OUT>,
					<&bpmp TEGRA194_CLK_SOR1_REF>,
					<&bpmp TEGRA194_CLK_SOR1_PAD_CLKOUT>,
					<&bpmp TEGRA194_CLK_SOR_SAFE>,
					<&bpmp TEGRA194_CLK_IQC1_IN>,
					<&bpmp TEGRA194_CLK_IQC2_IN>,
					<&bpmp TEGRA194_CLK_DMIC5>,
					<&bpmp TEGRA194_CLK_SPI1>,
					<&bpmp TEGRA194_CLK_SPI2>,
					<&bpmp TEGRA194_CLK_SPI3>,
					<&bpmp TEGRA194_CLK_I2C_SLOW>,
					<&bpmp TEGRA194_CLK_SYNC_DMIC1>,
					<&bpmp TEGRA194_CLK_SYNC_DMIC2>,
					<&bpmp TEGRA194_CLK_SYNC_DMIC3>,
					<&bpmp TEGRA194_CLK_SYNC_DMIC4>,
					<&bpmp TEGRA194_CLK_SYNC_DSPK1>,
					<&bpmp TEGRA194_CLK_SYNC_DSPK2>,
					<&bpmp TEGRA194_CLK_SYNC_I2S1>,
					<&bpmp TEGRA194_CLK_SYNC_I2S2>,
					<&bpmp TEGRA194_CLK_SYNC_I2S3>,
					<&bpmp TEGRA194_CLK_SYNC_I2S4>,
					<&bpmp TEGRA194_CLK_SYNC_I2S5>,
					<&bpmp TEGRA194_CLK_SYNC_I2S6>,
					<&bpmp TEGRA194_CLK_MPHY_FORCE_LS_MODE>,
					<&bpmp TEGRA194_CLK_TACH>,
					<&bpmp TEGRA194_CLK_TSEC>,
					<&bpmp TEGRA194_CLK_TSECB>,
					<&bpmp TEGRA194_CLK_UARTA>,
					<&bpmp TEGRA194_CLK_UARTB>,
					<&bpmp TEGRA194_CLK_UARTC>,
					<&bpmp TEGRA194_CLK_UARTD>,
					<&bpmp TEGRA194_CLK_UARTE>,
					<&bpmp TEGRA194_CLK_UARTF>,
					<&bpmp TEGRA194_CLK_UARTG>,
					<&bpmp TEGRA194_CLK_UART_FST_MIPI_CAL>,
					<&bpmp TEGRA194_CLK_UFSDEV_REF>,
					<&bpmp TEGRA194_CLK_UFSHC>,
					<&bpmp TEGRA194_CLK_USB2_TRK>,
					<&bpmp TEGRA194_CLK_VI>,
					<&bpmp TEGRA194_CLK_VIC>,
					<&bpmp TEGRA194_CLK_PVA0_AXI>,
					<&bpmp TEGRA194_CLK_PVA0_VPS0>,
					<&bpmp TEGRA194_CLK_PVA0_VPS1>,
					<&bpmp TEGRA194_CLK_PVA1_AXI>,
					<&bpmp TEGRA194_CLK_PVA1_VPS0>,
					<&bpmp TEGRA194_CLK_PVA1_VPS1>,
					<&bpmp TEGRA194_CLK_DLA0_FALCON>,
					<&bpmp TEGRA194_CLK_DLA0_CORE>,
					<&bpmp TEGRA194_CLK_DLA1_FALCON>,
					<&bpmp TEGRA194_CLK_DLA1_CORE>,
					<&bpmp TEGRA194_CLK_SOR2_OUT>,
					<&bpmp TEGRA194_CLK_SOR2_REF>,
					<&bpmp TEGRA194_CLK_SOR2_PAD_CLKOUT>,
					<&bpmp TEGRA194_CLK_SOR3_OUT>,
					<&bpmp TEGRA194_CLK_SOR3_REF>,
					<&bpmp TEGRA194_CLK_SOR3_PAD_CLKOUT>,
					<&bpmp TEGRA194_CLK_NVDISPLAY_P3>,
					<&bpmp TEGRA194_CLK_DPAUX2>,
					<&bpmp TEGRA194_CLK_DPAUX3>,
					<&bpmp TEGRA194_CLK_NVDEC1>,
					<&bpmp TEGRA194_CLK_NVENC1>,
					<&bpmp TEGRA194_CLK_SE_FREE>,
					<&bpmp TEGRA194_CLK_UARTH>,
					<&bpmp TEGRA194_CLK_FUSE_SERIAL>,
					<&bpmp TEGRA194_CLK_QSPI0>,
					<&bpmp TEGRA194_CLK_QSPI1>,
					<&bpmp TEGRA194_CLK_QSPI0_PM>,
					<&bpmp TEGRA194_CLK_QSPI1_PM>,
					<&bpmp TEGRA194_CLK_VI_CONST>,
					<&bpmp TEGRA194_CLK_NAFLL_BPMP>,
					<&bpmp TEGRA194_CLK_NAFLL_SCE>,
					<&bpmp TEGRA194_CLK_NAFLL_NVDEC>,
					<&bpmp TEGRA194_CLK_NAFLL_NVJPG>,
					<&bpmp TEGRA194_CLK_NAFLL_TSEC>,
					<&bpmp TEGRA194_CLK_NAFLL_TSECB>,
					<&bpmp TEGRA194_CLK_NAFLL_VI>,
					<&bpmp TEGRA194_CLK_NAFLL_SE>,
					<&bpmp TEGRA194_CLK_NAFLL_NVENC>,
					<&bpmp TEGRA194_CLK_NAFLL_ISP>,
					<&bpmp TEGRA194_CLK_NAFLL_VIC>,
					<&bpmp TEGRA194_CLK_NAFLL_NVDISPLAYHUB>,
					<&bpmp TEGRA194_CLK_NAFLL_AXICBB>,
					<&bpmp TEGRA194_CLK_NAFLL_DLA>,
					<&bpmp TEGRA194_CLK_NAFLL_PVA_CORE>,
					<&bpmp TEGRA194_CLK_NAFLL_PVA_VPS>,
					<&bpmp TEGRA194_CLK_NAFLL_CVNAS>,
					<&bpmp TEGRA194_CLK_NAFLL_RCE>,
					<&bpmp TEGRA194_CLK_NAFLL_NVENC1>,
					<&bpmp TEGRA194_CLK_NAFLL_DLA_FALCON>,
					<&bpmp TEGRA194_CLK_NAFLL_NVDEC1>,
					<&bpmp TEGRA194_CLK_NAFLL_GPU>,
					<&bpmp TEGRA194_CLK_SDMMC_LEGACY_TM>,
					<&bpmp TEGRA194_CLK_PEX0_CORE_0>,
					<&bpmp TEGRA194_CLK_PEX0_CORE_1>,
					<&bpmp TEGRA194_CLK_PEX0_CORE_2>,
					<&bpmp TEGRA194_CLK_PEX0_CORE_3>,
					<&bpmp TEGRA194_CLK_PEX0_CORE_4>,
					<&bpmp TEGRA194_CLK_PEX1_CORE_5>,
					<&bpmp TEGRA194_CLK_PEX_REF1>,
					<&bpmp TEGRA194_CLK_PEX_REF2>,
					<&bpmp TEGRA194_CLK_CSI_A>,
					<&bpmp TEGRA194_CLK_CSI_B>,
					<&bpmp TEGRA194_CLK_CSI_C>,
					<&bpmp TEGRA194_CLK_CSI_D>,
					<&bpmp TEGRA194_CLK_CSI_E>,
					<&bpmp TEGRA194_CLK_CSI_F>,
					<&bpmp TEGRA194_CLK_CSI_G>,
					<&bpmp TEGRA194_CLK_CSI_H>,
					<&bpmp TEGRA194_CLK_PLLC4>,
					<&bpmp TEGRA194_CLK_PLLC4_OUT>,
					<&bpmp TEGRA194_CLK_PLLC4_OUT1>,
					<&bpmp TEGRA194_CLK_PLLC4_OUT2>,
					<&bpmp TEGRA194_CLK_PLLC4_MUXED>,
					<&bpmp TEGRA194_CLK_PLLC4_VCO_DIV2>,
					<&bpmp TEGRA194_CLK_CSI_A_PAD>,
					<&bpmp TEGRA194_CLK_CSI_B_PAD>,
					<&bpmp TEGRA194_CLK_CSI_C_PAD>,
					<&bpmp TEGRA194_CLK_CSI_D_PAD>,
					<&bpmp TEGRA194_CLK_CSI_E_PAD>,
					<&bpmp TEGRA194_CLK_CSI_F_PAD>,
					<&bpmp TEGRA194_CLK_CSI_G_PAD>,
					<&bpmp TEGRA194_CLK_CSI_H_PAD>,
					<&bpmp TEGRA194_CLK_PEX_SATA_USB_RX_BYP>,
					<&bpmp TEGRA194_CLK_PEX_USB_PAD_PLL0_MGMT>,
					<&bpmp TEGRA194_CLK_PEX_USB_PAD_PLL1_MGMT>,
					<&bpmp TEGRA194_CLK_PEX_USB_PAD_PLL2_MGMT>,
					<&bpmp TEGRA194_CLK_PEX_USB_PAD_PLL3_MGMT>,
					<&bpmp TEGRA194_CLK_XUSB_CORE_DEV>,
					<&bpmp TEGRA194_CLK_XUSB_CORE_MUX>,
					<&bpmp TEGRA194_CLK_XUSB_CORE_HOST>,
					<&bpmp TEGRA194_CLK_XUSB_CORE_SS>,
					<&bpmp TEGRA194_CLK_XUSB_FALCON>,
					<&bpmp TEGRA194_CLK_XUSB_FALCON_HOST>,
					<&bpmp TEGRA194_CLK_XUSB_FALCON_SS>,
					<&bpmp TEGRA194_CLK_XUSB_FS>,
					<&bpmp TEGRA194_CLK_XUSB_FS_HOST>,
					<&bpmp TEGRA194_CLK_XUSB_FS_DEV>,
					<&bpmp TEGRA194_CLK_XUSB_SS>,
					<&bpmp TEGRA194_CLK_XUSB_SS_DEV>,
					<&bpmp TEGRA194_CLK_XUSB_SS_SUPERSPEED>,
					<&bpmp TEGRA194_CLK_PLLDISPHUB>,
					<&bpmp TEGRA194_CLK_PLLDISPHUB_DIV>,
					<&bpmp TEGRA194_CLK_NAFLL_CLUSTER0>,
					<&bpmp TEGRA194_CLK_NAFLL_CLUSTER1>,
					<&bpmp TEGRA194_CLK_NAFLL_CLUSTER2>,
					<&bpmp TEGRA194_CLK_NAFLL_CLUSTER3>,
					<&bpmp TEGRA194_CLK_CAN1_CORE>,
					<&bpmp TEGRA194_CLK_CAN2_CORE>,
					<&bpmp TEGRA194_CLK_PLLA1_OUT1>,
					<&bpmp TEGRA194_CLK_PLLREFE_VCOOUT>,
					<&bpmp TEGRA194_CLK_CLK_32K>,
					<&bpmp TEGRA194_CLK_SPDIFIN_SYNC_INPUT>,
					<&bpmp TEGRA194_CLK_UTMIPLL_CLKOUT48>,
					<&bpmp TEGRA194_CLK_UTMIPLL_CLKOUT480>,
					<&bpmp TEGRA194_CLK_CVNAS>,
					<&bpmp TEGRA194_CLK_PLLNVCSI>,
					<&bpmp TEGRA194_CLK_PVA0_CPU_AXI>,
					<&bpmp TEGRA194_CLK_PVA1_CPU_AXI>,
					<&bpmp TEGRA194_CLK_PVA0_VPS>,
					<&bpmp TEGRA194_CLK_PVA1_VPS>,
					<&bpmp TEGRA194_CLK_DLA0_FALCON_MUX>,
					<&bpmp TEGRA194_CLK_DLA1_FALCON_MUX>,
					<&bpmp TEGRA194_CLK_DLA0_CORE_MUX>,
					<&bpmp TEGRA194_CLK_DLA1_CORE_MUX>,
					<&bpmp TEGRA194_CLK_UTMIPLL_HPS>,
					<&bpmp TEGRA194_CLK_I2C5>,
					<&bpmp TEGRA194_CLK_I2C10>,
					<&bpmp TEGRA194_CLK_BPMP_CPU_NIC>,
					<&bpmp TEGRA194_CLK_BPMP_APB>,
					<&bpmp TEGRA194_CLK_TSC>,
					<&bpmp TEGRA194_CLK_EMCSA>,
					<&bpmp TEGRA194_CLK_EMCSB>,
					<&bpmp TEGRA194_CLK_EMCSC>,
					<&bpmp TEGRA194_CLK_EMCSD>,
					<&bpmp TEGRA194_CLK_PLLC>,
					<&bpmp TEGRA194_CLK_PLLC2>,
					<&bpmp TEGRA194_CLK_PLLC3>,
					<&bpmp TEGRA194_CLK_PLLE_HPS>;
				clock-names = "actmon",
					"adsp",
					"adspneon",
					"ahub",
					"apb2ape",
					"ape",
					"aud_mclk",
					"axi_cbb",
					"can1",
					"can1_host",
					"can2",
					"can2_host",
					"cec",
					"clk_m",
					"dmic1",
					"dmic2",
					"dmic3",
					"dmic4",
					"dpaux",
					"dpaux1",
					"aclk",
					"mss_encrypt",
					"eqos_rx_input",
					"icq2",
					"aon_apb",
					"aon_nic",
					"aon_cpu_nic",
					"plla1",
					"dspk1",
					"dspk2",
					"emc",
					"eqos_axi",
					"eqos_ptp_ref",
					"eqos_rx",
					"eqos_tx",
					"extperiph1",
					"extperiph2",
					"extperiph3",
					"extperiph4",
					"fuse",
					"gpcclk",
					"gpu_pwr",
					"hda",
					"hda2codec_2x",
					"hda2hdmicodec",
					"host1x",
					"hsic_trk",
					"i2c1",
					"i2c2",
					"i2c3",
					"i2c4",
					"i2c6",
					"i2c7",
					"i2c8",
					"i2c9",
					"i2s1",
					"i2s1_sync_input",
					"i2s2",
					"i2s2_sync_input",
					"i2s3",
					"i2s3_sync_input",
					"i2s4",
					"i2s4_sync_input",
					"i2s5",
					"i2s5_sync_input",
					"i2s6",
					"i2s6_sync_input",
					"iqc1",
					"isp",
					"kfuse",
					"maud",
					"mipi_cal",
					"mphy_core_pll_fixed",
					"mphy_l0_rx_ana",
					"mphy_l0_rx_ls_bit",
					"mphy_l0_rx_symb",
					"mphy_l0_tx_ls_3xbit",
					"mphy_l0_tx_symb",
					"mphy_l1_rx_ana",
					"mphy_tx_1mhz_ref",
					"nvcsi",
					"nvcsilp",
					"nvdec",
					"nvdisplayhub",
					"nvdisplay_disp",
					"nvdisplay_p0",
					"nvdisplay_p1",
					"nvdisplay_p2",
					"nvenc",
					"nvjpg",
					"osc",
					"aon_touch",
					"plla",
					"pllaon",
					"plld",
					"plld2",
					"plld3",
					"plldp",
					"plld4",
					"plle",
					"pllp",
					"pllp_out0",
					"utmipll",
					"plla_out0",
					"pwm1",
					"pwm2",
					"pwm3",
					"pwm4",
					"pwm5",
					"pwm6",
					"pwm7",
					"pwm8",
					"rce_cpu_nic",
					"rce_nic",
					"sata",
					"sata_oob",
					"aon_i2c_slow",
					"sce_cpu_nic",
					"sce_nic",
					"sdmmc1",
					"uphy_pll3",
					"sdmmc3",
					"sdmmc4",
					"se",
					"sor0_out",
					"sor0_ref",
					"sor0_pad_clkout",
					"sor1_out",
					"sor1_ref",
					"sor1_pad_clkout",
					"sor_safe",
					"iqc1_in",
					"iqc2_in",
					"dmic5",
					"spi1",
					"spi2",
					"spi3",
					"i2c_slow",
					"sync_dmic1",
					"sync_dmic2",
					"sync_dmic3",
					"sync_dmic4",
					"sync_dspk1",
					"sync_dspk2",
					"sync_i2s1",
					"sync_i2s2",
					"sync_i2s3",
					"sync_i2s4",
					"sync_i2s5",
					"sync_i2s6",
					"mphy_force_ls_mode",
					"tach",
					"tsec",
					"tsecb",
					"uarta",
					"uartb",
					"uartc",
					"uartd",
					"uarte",
					"uartf",
					"uartg",
					"uart_fst_mipi_cal",
					"ufsdev_ref",
					"ufshc",
					"usb2_trk",
					"vi",
					"vic",
					"pva0_axi",
					"pva0_vps0",
					"pva0_vps1",
					"pva1_axi",
					"pva1_vps0",
					"pva1_vps1",
					"dla0_falcon",
					"dla0_core",
					"dla1_falcon",
					"dla1_core",
					"sor2_out",
					"sor2_ref",
					"sor2_pad_clkout",
					"sor3_out",
					"sor3_ref",
					"sor3_pad_clkout",
					"nvdisplay_p3",
					"dpaux2",
					"dpaux3",
					"nvdec1",
					"nvenc1",
					"se_free",
					"uarth",
					"fuse_serial",
					"qspi0",
					"qspi1",
					"qspi0_pm",
					"qspi1_pm",
					"vi_const",
					"nafll_bpmp",
					"nafll_sce",
					"nafll_nvdec",
					"nafll_nvjpg",
					"nafll_tsec",
					"nafll_tsecb",
					"nafll_vi",
					"nafll_se",
					"nafll_nvenc",
					"nafll_isp",
					"nafll_vic",
					"nafll_nvdisplayhub",
					"nafll_axicbb",
					"nafll_dla",
					"nafll_pva_core",
					"nafll_pva_vps",
					"nafll_cvnas",
					"nafll_rce",
					"nafll_nvenc1",
					"nafll_dla_falcon",
					"nafll_nvdec1",
					"nafll_gpu",
					"sdmmc_legacy_tm",
					"pex0_core_0",
					"pex0_core_1",
					"pex0_core_2",
					"pex0_core_3",
					"pex0_core_4",
					"pex1_core_5",
					"pex_ref1",
					"pex_ref2",
					"csi_a",
					"csi_b",
					"csi_c",
					"csi_d",
					"csi_e",
					"csi_f",
					"csi_g",
					"csi_h",
					"pllc4",
					"pllc4_out",
					"pllc4_out1",
					"pllc4_out2",
					"pllc4_muxed",
					"pllc4_vco_div2",
					"csi_a_pad",
					"csi_b_pad",
					"csi_c_pad",
					"csi_d_pad",
					"csi_e_pad",
					"csi_f_pad",
					"csi_g_pad",
					"csi_h_pad",
					"pex_sata_usb_rx_byp",
					"pex_usb_pad_pll0_mgmt",
					"pex_usb_pad_pll1_mgmt",
					"pex_usb_pad_pll2_mgmt",
					"pex_usb_pad_pll3_mgmt",
					"xusb_core_dev",
					"xusb_core_mux",
					"xusb_core_host",
					"xusb_core_ss",
					"xusb_falcon",
					"xusb_falcon_host",
					"xusb_falcon_ss",
					"xusb_fs",
					"xusb_fs_host",
					"xusb_fs_dev",
					"xusb_ss",
					"xusb_ss_dev",
					"xusb_ss_superspeed",
					"plldisphub",
					"plldisphub_div",
					"nafll_cluster0",
					"nafll_cluster1",
					"nafll_cluster2",
					"nafll_cluster3",
					"can1_core",
					"can2_core",
					"plla1_out1",
					"pllrefe_vcoout",
					"clk_32k",
					"spdifin_sync_input",
					"utmipll_clkout48",
					"utmipll_clkout480",
					"cvnas",
					"pllnvcsi",
					"pva0_cpu_axi",
					"pva1_cpu_axi",
					"pva0_vps",
					"pva1_vps",
					"dla0_falcon_mux",
					"dla1_falcon_mux",
					"dla0_core_mux",
					"dla1_core_mux",
					"utmipll_hps",
					"i2c5",
					"i2c10",
					"bpmp_cpu_nic",
					"bpmp_apb",
					"tsc",
					"emcsa",
					"emcsb",
					"emcsc",
					"emcsd",
					"pll_c",
					"pll_c2",
					"pll_c3",
					"plle_hps";

				resets = <&bpmp TEGRA194_RESET_ACTMON>,
					<&bpmp TEGRA194_RESET_ADSP_ALL>,
					<&bpmp TEGRA194_RESET_AFI>,
					<&bpmp TEGRA194_RESET_CAN1>,
					<&bpmp TEGRA194_RESET_CAN2>,
					<&bpmp TEGRA194_RESET_DLA0>,
					<&bpmp TEGRA194_RESET_DLA1>,
					<&bpmp TEGRA194_RESET_DPAUX>,
					<&bpmp TEGRA194_RESET_DPAUX1>,
					<&bpmp TEGRA194_RESET_DPAUX2>,
					<&bpmp TEGRA194_RESET_DPAUX3>,
					<&bpmp TEGRA194_RESET_EQOS>,
					<&bpmp TEGRA194_RESET_GPCDMA>,
					<&bpmp TEGRA194_RESET_GPU>,
					<&bpmp TEGRA194_RESET_HDA>,
					<&bpmp TEGRA194_RESET_HDA2CODEC_2X>,
					<&bpmp TEGRA194_RESET_HDA2HDMICODEC>,
					<&bpmp TEGRA194_RESET_HOST1X>,
					<&bpmp TEGRA194_RESET_I2C1>,
					<&bpmp TEGRA194_RESET_I2C10>,
					<&bpmp TEGRA194_RESET_I2C2>,
					<&bpmp TEGRA194_RESET_I2C3>,
					<&bpmp TEGRA194_RESET_I2C4>,
					<&bpmp TEGRA194_RESET_I2C6>,
					<&bpmp TEGRA194_RESET_I2C7>,
					<&bpmp TEGRA194_RESET_I2C8>,
					<&bpmp TEGRA194_RESET_I2C9>,
					<&bpmp TEGRA194_RESET_ISP>,
					<&bpmp TEGRA194_RESET_MIPI_CAL>,
					<&bpmp TEGRA194_RESET_MPHY_CLK_CTL>,
					<&bpmp TEGRA194_RESET_MPHY_L0_RX>,
					<&bpmp TEGRA194_RESET_MPHY_L0_TX>,
					<&bpmp TEGRA194_RESET_MPHY_L1_RX>,
					<&bpmp TEGRA194_RESET_MPHY_L1_TX>,
					<&bpmp TEGRA194_RESET_NVCSI>,
					<&bpmp TEGRA194_RESET_NVDEC>,
					<&bpmp TEGRA194_RESET_NVDISPLAY0_HEAD0>,
					<&bpmp TEGRA194_RESET_NVDISPLAY0_HEAD1>,
					<&bpmp TEGRA194_RESET_NVDISPLAY0_HEAD2>,
					<&bpmp TEGRA194_RESET_NVDISPLAY0_HEAD3>,
					<&bpmp TEGRA194_RESET_NVDISPLAY0_MISC>,
					<&bpmp TEGRA194_RESET_NVDISPLAY0_WGRP0>,
					<&bpmp TEGRA194_RESET_NVDISPLAY0_WGRP1>,
					<&bpmp TEGRA194_RESET_NVDISPLAY0_WGRP2>,
					<&bpmp TEGRA194_RESET_NVDISPLAY0_WGRP3>,
					<&bpmp TEGRA194_RESET_NVDISPLAY0_WGRP4>,
					<&bpmp TEGRA194_RESET_NVDISPLAY0_WGRP5>,
					<&bpmp TEGRA194_RESET_NVENC>,
					<&bpmp TEGRA194_RESET_NVENC1>,
					<&bpmp TEGRA194_RESET_NVJPG>,
					<&bpmp TEGRA194_RESET_PCIE>,
					<&bpmp TEGRA194_RESET_PCIEXCLK>,
					<&bpmp TEGRA194_RESET_PVA0_ALL>,
					<&bpmp TEGRA194_RESET_PVA1_ALL>,
					<&bpmp TEGRA194_RESET_PWM1>,
					<&bpmp TEGRA194_RESET_PWM2>,
					<&bpmp TEGRA194_RESET_PWM3>,
					<&bpmp TEGRA194_RESET_PWM4>,
					<&bpmp TEGRA194_RESET_PWM5>,
					<&bpmp TEGRA194_RESET_PWM6>,
					<&bpmp TEGRA194_RESET_PWM7>,
					<&bpmp TEGRA194_RESET_PWM8>,
					<&bpmp TEGRA194_RESET_QSPI0>,
					<&bpmp TEGRA194_RESET_QSPI1>,
					<&bpmp TEGRA194_RESET_SATA>,
					<&bpmp TEGRA194_RESET_SATACOLD>,
					<&bpmp TEGRA194_RESET_SCE_ALL>,
					<&bpmp TEGRA194_RESET_RCE_ALL>,
					<&bpmp TEGRA194_RESET_SDMMC1>,
					<&bpmp TEGRA194_RESET_SDMMC3>,
					<&bpmp TEGRA194_RESET_SDMMC4>,
					<&bpmp TEGRA194_RESET_SE>,
					<&bpmp TEGRA194_RESET_SOR0>,
					<&bpmp TEGRA194_RESET_SOR1>,
					<&bpmp TEGRA194_RESET_SOR2>,
					<&bpmp TEGRA194_RESET_SOR3>,
					<&bpmp TEGRA194_RESET_SPI1>,
					<&bpmp TEGRA194_RESET_SPI2>,
					<&bpmp TEGRA194_RESET_SPI3>,
					<&bpmp TEGRA194_RESET_SPI4>,
					<&bpmp TEGRA194_RESET_TACH>,
					<&bpmp TEGRA194_RESET_TSCTNVI>,
					<&bpmp TEGRA194_RESET_TSEC>,
					<&bpmp TEGRA194_RESET_TSECB>,
					<&bpmp TEGRA194_RESET_UARTA>,
					<&bpmp TEGRA194_RESET_UARTB>,
					<&bpmp TEGRA194_RESET_UARTC>,
					<&bpmp TEGRA194_RESET_UARTD>,
					<&bpmp TEGRA194_RESET_UARTE>,
					<&bpmp TEGRA194_RESET_UARTF>,
					<&bpmp TEGRA194_RESET_UARTG>,
					<&bpmp TEGRA194_RESET_UARTH>,
					<&bpmp TEGRA194_RESET_UFSHC>,
					<&bpmp TEGRA194_RESET_UFSHC_AXI_M>,
					<&bpmp TEGRA194_RESET_UFSHC_LP_SEQ>,
					<&bpmp TEGRA194_RESET_VI>,
					<&bpmp TEGRA194_RESET_VIC>,
					<&bpmp TEGRA194_RESET_XUSB_PADCTL>,
					<&bpmp TEGRA194_RESET_NVDEC1>,
					<&bpmp TEGRA194_RESET_PEX0_CORE_0>,
					<&bpmp TEGRA194_RESET_PEX0_CORE_1>,
					<&bpmp TEGRA194_RESET_PEX0_CORE_2>,
					<&bpmp TEGRA194_RESET_PEX0_CORE_3>,
					<&bpmp TEGRA194_RESET_PEX0_CORE_4>,
					<&bpmp TEGRA194_RESET_PEX0_CORE_0_APB>,
					<&bpmp TEGRA194_RESET_PEX0_CORE_1_APB>,
					<&bpmp TEGRA194_RESET_PEX0_CORE_2_APB>,
					<&bpmp TEGRA194_RESET_PEX0_CORE_3_APB>,
					<&bpmp TEGRA194_RESET_PEX0_CORE_4_APB>,
					<&bpmp TEGRA194_RESET_PEX0_COMMON_APB>,
					<&bpmp TEGRA194_RESET_PEX1_CORE_5>,
					<&bpmp TEGRA194_RESET_PEX1_CORE_5_APB>,
					<&bpmp TEGRA194_RESET_CVNAS>,
					<&bpmp TEGRA194_RESET_CVNAS_FCM>,
					<&bpmp TEGRA194_RESET_DMIC5>,
					<&bpmp TEGRA194_RESET_APE>,
					<&bpmp TEGRA194_RESET_PEX_USB_UPHY>,
					<&bpmp TEGRA194_RESET_PEX_USB_UPHY_L0>,
					<&bpmp TEGRA194_RESET_PEX_USB_UPHY_L1>,
					<&bpmp TEGRA194_RESET_PEX_USB_UPHY_L2>,
					<&bpmp TEGRA194_RESET_PEX_USB_UPHY_L3>,
					<&bpmp TEGRA194_RESET_PEX_USB_UPHY_L4>,
					<&bpmp TEGRA194_RESET_PEX_USB_UPHY_L5>,
					<&bpmp TEGRA194_RESET_PEX_USB_UPHY_L6>,
					<&bpmp TEGRA194_RESET_PEX_USB_UPHY_L7>,
					<&bpmp TEGRA194_RESET_PEX_USB_UPHY_L8>,
					<&bpmp TEGRA194_RESET_PEX_USB_UPHY_L9>,
					<&bpmp TEGRA194_RESET_PEX_USB_UPHY_L10>,
					<&bpmp TEGRA194_RESET_PEX_USB_UPHY_L11>,
					<&bpmp TEGRA194_RESET_PEX_USB_UPHY_PLL0>,
					<&bpmp TEGRA194_RESET_PEX_USB_UPHY_PLL1>,
					<&bpmp TEGRA194_RESET_PEX_USB_UPHY_PLL2>,
					<&bpmp TEGRA194_RESET_PEX_USB_UPHY_PLL3>;
				reset-names = "actmon",
					"adsp_all",
					"afi",
					"can1",
					"can2",
					"dla0",
					"dla1",
					"dpaux",
					"dpaux1",
					"dpaux2",
					"dpaux3",
					"eqos",
					"gpcdma",
					"gpu",
					"hda",
					"hda2codec_2x",
					"hda2hdmicodec",
					"host1x",
					"i2c1",
					"i2c10",
					"i2c2",
					"i2c3",
					"i2c4",
					"i2c6",
					"i2c7",
					"i2c8",
					"i2c9",
					"isp",
					"mipi_cal",
					"mphy_clk_ctl",
					"mphy_l0_rx",
					"mphy_l0_tx",
					"mphy_l1_rx",
					"mphy_l1_tx",
					"nvcsi",
					"nvdec",
					"nvdisplay0_head0",
					"nvdisplay0_head1",
					"nvdisplay0_head2",
					"nvdisplay0_head3",
					"nvdisplay0_misc",
					"nvdisplay0_wgrp0",
					"nvdisplay0_wgrp1",
					"nvdisplay0_wgrp2",
					"nvdisplay0_wgrp3",
					"nvdisplay0_wgrp4",
					"nvdisplay0_wgrp5",
					"nvenc",
					"nvenc1",
					"nvjpg",
					"pcie",
					"pciexclk",
					"pva0_all",
					"pva1_all",
					"pwm1",
					"pwm2",
					"pwm3",
					"pwm4",
					"pwm5",
					"pwm6",
					"pwm7",
					"pwm8",
					"qspi0",
					"qspi1",
					"sata",
					"satacold",
					"sce_all",
					"rce_all",
					"sdmmc1",
					"sdmmc3",
					"sdmmc4",
					"se",
					"sor0",
					"sor1",
					"sor2",
					"sor3",
					"spi1",
					"spi2",
					"spi3",
					"spi4",
					"tach",
					"tsctnvi",
					"tsec",
					"tsecb",
					"uarta",
					"uartb",
					"uartc",
					"uartd",
					"uarte",
					"uartf",
					"uartg",
					"uarth",
					"ufshc",
					"ufshc_axi_m",
					"ufshc_lp_seq",
					"vi",
					"vic",
					"xusb_padctl",
					"nvdec1",
					"pex0_core_0",
					"pex0_core_1",
					"pex0_core_2",
					"pex0_core_3",
					"pex0_core_4",
					"pex0_core_0_apb",
					"pex0_core_1_apb",
					"pex0_core_2_apb",
					"pex0_core_3_apb",
					"pex0_core_4_apb",
					"pex0_common_apb",
					"pex1_core_5",
					"pex1_core_5_apb",
					"cvnas",
					"cvnas_fcm",
					"dmic5",
					"ape",
					"pex_usb_uphy",
					"pex_usb_uphy_l0",
					"pex_usb_uphy_l1",
					"pex_usb_uphy_l2",
					"pex_usb_uphy_l3",
					"pex_usb_uphy_l4",
					"pex_usb_uphy_l5",
					"pex_usb_uphy_l6",
					"pex_usb_uphy_l7",
					"pex_usb_uphy_l8",
					"pex_usb_uphy_l9",
					"pex_usb_uphy_l10",
					"pex_usb_uphy_l11",
					"pex_usb_uphy_pll0",
					"pex_usb_uphy_pll1",
					"pex_usb_uphy_pll2",
					"pex_usb_uphy_pll3";
			};
	};
};

